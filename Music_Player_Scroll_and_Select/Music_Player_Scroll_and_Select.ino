#include <Wire.h>
#include <rgb_lcd.h>

rgb_lcd lcd; //Initiate "lcd"

//Pin Variables
const int potPin = A0;
const int buttonPin = 3;
const int speakerPin = 5;
//const int speakerPin1 = 4;
const int random_noise_pin = A1;

//Scrolling and Songs
const int maxSong = 5;   //Value of max songs **********!!!!!!***********//
int scrollLevel; //Level that is showing!
int noteIndex = 0;
int noteIndices[] = {0, 0};
int song_last_played = -1; //TODO check null value---This is an arbitrary number.

//Sprites
byte pauseButton[8] = { 0,27,27,27,27,27,27, 0};   //Pause Button Sprite
byte playButton[8]  = { 8,12,14,15,14,12, 8, 0};   //Play Button Sprite

//Song Names
String songNames[maxSong][2] {
    {"Poker Face", ""},
    {"Imperial", "March"},
    {"Super Mario", "Bros."},
    {"Never Gonna", "Give You Urp"},
    {"Turret", "Opera"},
};

//Used to check when the selected song number changes
int scrollSwitch[2] = {0,0};

const int songList[maxSong][2][10000] = { //Hack-y, fix the maxSong to accommodate two-track songs
  //NOTATIOIN:
  // Each song is an array of 2 arrays. The first one is frequencies, and the second is durations.
  
  //Poker Face - #0
  {
    {220, 220, 220, 220, 220, 220, 329, 329, 329, 329, 220, 220, 220,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 261, -1},
    {494, 1, 251, 1, 251, 1, 251, 1, 251, 1, 251, 1, 251,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 755, -1}
  },
  
  //Imperial March - #1
  {
    {195, 195, 195, 195, 195, 195, 155, 155, 233, 233, 195, 195, 155,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 195, -1},
    {498, 1, 498, 1, 498, 1, 373, 1, 123, 1, 498, 1, 373,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 498, -1}
  },

  //Super Mario Bros - #2
  {
    {329, 329, 329, 329, 329, 329, 261, 261, 329, 329, 391, 391, 195,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 164, -1},
    {240, 1, 248, 251, 248, 251, 248, 1, 498, 1, 498, 501, 498,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 1498, -1}
  },

  //Never Gonna Give you Up - #3
  {
    {466, 466, 523, 523, 523, 523, 587, 587, 698, 698, 622, 622, 587,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 466, -1},
    {740, 1, 1248, 1, 748, 1, 748, 1, 123, 1, 123, 1, 123,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 998, -1}
  },

  //Turret Opera
  {
    {880, 880, 932, 932, 1046, 1046, 932, 932, 880, 880, 1174, 1174, 1046,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 1174, -1},
    {588, 1, 298, 301, 598, 1, 298, 1, 298, 1, 298, 1, 298,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 2398, -1}
  },

};

//Time Variables
unsigned long currentTime;
unsigned long time_since_last_press = 0;
const int debounceTime = 250;                  //Milliseconds of buffer time

//Random Variables
int random_period = 0;
int random_trigger = 1;

//Sensors
int potPosition;
bool buttonPosition;

int checkPot_and_scrollLevel(){      //Return scroll value
  potPosition = analogRead(potPin);
  delay(10);
  scrollLevel = map(potPosition,0,1023,0,maxSong);
  if(scrollLevel == maxSong){
    scrollLevel--;
  }
  return scrollLevel;
}

bool checkSelect(){
  currentTime = millis();
  buttonPosition = digitalRead(buttonPin);
  if(buttonPosition == true && millis()>= time_since_last_press + debounceTime){
    time_since_last_press = millis();
    return true;
  }
  else{
    return false;
  }
}

//Plays the song
//Uses one parameter, which must be a 2-deminsional array.
//  Must include frequencies in the first part and durations in the second.

void play_song(const int song[2][10000]){
  if(song_last_played != scrollLevel || song[0][noteIndex + 1] == -1){
    song_last_played = scrollLevel;
    noteIndex = 0;
  }
  long timeNotePlayed;
  bool shouldBreak;
  
  for (; noteIndex < 10000; noteIndex++) {
    tone(speakerPin, song[0][noteIndex]);
    timeNotePlayed = millis();
    shouldBreak = false;

    random_period++;
    if(random_period >= random_trigger){
      random_screen_color();
      random_period = 0;
    }
   
    while (millis() - timeNotePlayed < song[1][noteIndex]){
      delay(10);
      if(checkSelect() == true){
        shouldBreak = true;
        break;
      }
    }
    if (shouldBreak == true || song[0][noteIndex + 1] == -1){
      noTone(speakerPin);
      lcd.setRGB(255,255,255);
      changePlayButton(0);
      break;
    }
  }
}

/*void play_song_multi(const int track1[2][10000], const int track2[2][10000]){
  if (song_last_played != scrollLevel || track1[noteIndices[0]][noteIndices[1]] == -1){
    song_last_played = scrollLevel;
    noteIndices[0] = 0;
    noteIndices[1] = 0;
  }

  int i = 0;
  int j = 0;
  long halfPeriod[] = {500000.0 / track1[0][i], 500000.0 / track2[0][j]};
  long noteStart[] = {micros(), micros()};
  long timePlaying[] = {32768 + micros(), 32768 + micros()};
  
  while (1){
    //First track
    if (track1[0][i] == -1 || track2[0][j] == -1 || checkSelect() == true){
      digitalWrite(speakerPin, LOW);
      digitalWrite(speakerPin1, LOW);
      break;
    }
    if (timePlaying[0] - noteStart[0] > (track1[1][i]) * 1000){ //1st row = durations
      i++;
      halfPeriod[0] = (500000.0 / track1[0][i]); //0th row = frequencies
      noteStart[0] = micros();
      timePlaying[0] = micros();
    }
    Serial.println("Playing note " + String(i) + " on track 1");
    digitalWrite(speakerPin, HIGH);
    delayMicroseconds(halfPeriod[0]);
    digitalWrite(speakerPin, LOW);
    delayMicroseconds(halfPeriod[0]);
    timePlaying[0] += 2 * halfPeriod[0];
    Serial.println("timePlaying[0] =" + String(timePlaying[0]));

    //Second track
    if (timePlaying[1] - noteStart[1] > (track2[1][j]) * 1000){ //1st row = durations
      j++;
      halfPeriod[1] = (500000.0 / track2[0][j]); //0th row = frequencies
      noteStart[1] = micros();
      timePlaying[1] = micros();
    }

    Serial.println("Playing note " + String(j) + " on track 2");
    digitalWrite(speakerPin1, HIGH);
    delayMicroseconds(halfPeriod[1]);
    digitalWrite(speakerPin1, LOW);
    delayMicroseconds(halfPeriod[1]);
    timePlaying[1] += 2 * halfPeriod[1];
  }
}
*/
/*
void play_song(int noteList[],float noteLength[]){
  if(song_last_played != scrollLevel){
    song_last_played = scrollLevel;
    noteIndex = 0;
  }
    for (; noteIndex < 10000; noteIndex++) {
      if(checkSelect() == true || noteList[noteIndex] == -1){
        changePlayButton(0);
        break;
      }                                                                    //Will keep for a few versions
      tone(speakerPin, noteList[noteIndex], noteLength[noteIndex]);
  }
}
*/



void screenScroll(int scrollLevel) {
    //The if statement is for button. Do not use with potentiometer.    
    lcd.clear();
    lcd.setCursor(0, 0);
    lcd.print(scrollLevel + 1);
    lcd.setCursor( (16 - songNames[scrollLevel][0].length() ) / 2 , 0);
    lcd.print(songNames[scrollLevel][0]);
    lcd.setCursor( (16 - songNames[scrollLevel][1].length() ) / 2 , 1);
    lcd.print(songNames[scrollLevel][1]);
    if(song_last_played == scrollLevel){
      changePlayButton(0);
    }
    delay(5);
    }
    
void changePlayButton(int state){
  lcd.setCursor(15,0);
  if (state == 0){
    lcd.write(byte(0)); //Pause Button
    }
  else if(state == 1){
    lcd.write(byte(1)); //Play Button
  }
}

int randomNumber(){
  int randomVariable = random();
  return randomVariable;
}

void random_screen_color(){
  lcd.setRGB(randomNumber(),randomNumber(),randomNumber());
}

void setup() {
  Serial.begin(9600);
  pinMode(potPin,INPUT);
  pinMode(buttonPin, INPUT);
  pinMode(speakerPin, OUTPUT);
  //pinMode(speakerPin1, OUTPUT);
  lcd.begin(16, 2);
  lcd.createChar(0, pauseButton);
  lcd.createChar(1, playButton);
  randomSeed(analogRead(random_noise_pin));
  screenScroll(checkPot_and_scrollLevel());
 }


void loop() {
  //Checks to see if button is not pressed.
  if (checkSelect() == false) {
    //Next few lines check to see if you scrolled to a different song.
    scrollSwitch[0] = scrollSwitch[1];
    scrollSwitch[1] = checkPot_and_scrollLevel();
    if (scrollSwitch[0] != scrollSwitch[1]) {
      screenScroll(checkPot_and_scrollLevel());
    }
  }
  else {
    changePlayButton(1);
    play_song(songList[scrollLevel]);
  }
  /*else {
    if (scrollLevel == 4){
      play_song_multi(songList[scrollLevel], songList[scrollLevel+1]);
    } else {
    changePlayButton(1);
    play_song(songList[scrollLevel]);
    }
  }*/
}

